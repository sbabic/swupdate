## bootloader/Config.in
```kconfig
# SPDX-FileCopyrightText: 2017 Stefano Babic <stefano.babic@swupdate.org>
#
# SPDX-License-Identifier: GPL-2.0-only

menu "Bootloader Interfaces"

config BOOTLOADER_NONE
	bool "Environment in RAM"
	default y
	help
	  This simulates the interface to a bootloader.
	  Bootloader environment is just maintained in RAM
	  and lost when SWUpdate exits.

config BOOTLOADER_EBG
	bool "EFI Boot Guard"
	depends on HAVE_LIBEBGENV
	help
	  Support for EFI Boot Guard
	  https://github.com/siemens/efibootguard

comment "EFI Boot Guard needs libebgenv and libz"
	depends on !HAVE_ZLIB || !HAVE_LIBEBGENV

config UBOOT
	bool "U-Boot"
	depends on HAVE_LIBUBOOTENV
	help
	  Support for U-Boot
	  https://www.denx.de/wiki/U-Boot

comment "U-Boot needs libubootenv"
	depends on !HAVE_LIBUBOOTENV

config UBOOT_FWENV
	string "U-Boot Environment Configuration file"
	depends on UBOOT
	default "/etc/fw_env.config"
	help
	  This is the file described in U-Boot documentation
	  in the tools directory. It tells where the U-Boot
	  environment is saved.

config UBOOT_DEFAULTENV
	string "U-Boot Initial Environment file"
	depends on UBOOT
	default "/etc/u-boot-initial-env"
	help
	  This is the file with the initial environment delivered
	  with the bootloader. It is used by SWUpdate if no environment
	  is found on the storage.

config BOOTLOADER_GRUB
	bool "GRUB"
	help
	  Support for GRUB
	  https://www.gnu.org/software/grub/

config GRUBENV_PATH
	string "GRUB Environment block file path"
	depends on BOOTLOADER_GRUB
	default "/boot/efi/EFI/BOOT/grub/grubenv"
	help
	  Provide path to GRUB environment block file

config BOOTLOADER_CBOOT
	bool "NVIDIA Tegra Cboot"
	depends on HAVE_LIBTEGRABOOT_TOOLS
	help
	  Support for NVIDIA's cboot used on some Tegra platform. Tegra
	  uses different bootloader, depending on the SOC and on the release
	  provided by vendor. Some SOCs (associated with some releases) are still
	  using U-Boot (Jetson Nano, TX, TX2), some of them are using Cboot (Xavier),
	  and some of them rely on UEFI. This adds support for cboot.

comment "Cboot needs libtegra-boot-tools"
	depends on !HAVE_LIBTEGRABOOT_TOOLS

endmenu

choice
	prompt "Default Bootloader Interface"
	help
	  Default bootloader interface to use if not explicitly
	  overridden via configuration or command-line option
	  at run-time.

config BOOTLOADER_DEFAULT_EBG
	bool "EBG"
	depends on BOOTLOADER_EBG
	help
	  Use EFI Boot Guard as default bootloader interface.
	  
	  Note: Make sure the environment modification shared
	  library https://github.com/siemens/efibootguard (including
	  dependencies) is installed on the target system.

config BOOTLOADER_DEFAULT_UBOOT
	bool "U-Boot"
	depends on UBOOT
	help
	  Use U-Boot as default bootloader interface.
	  
	  Note: Make sure the environment modification shared
	  library https://github.com/sbabic/libubootenv (including
	  dependencies) is installed on the target system.

config BOOTLOADER_DEFAULT_GRUB
	bool "GRUB"
	depends on BOOTLOADER_GRUB
	help
	  Use GRUB as default bootloader interface.

config BOOTLOADER_DEFAULT_CBOOT
	bool "Cboot"
	depends on BOOTLOADER_CBOOT
	help
	  Use NVIDIA Cboot as default bootloader interface.

config BOOTLOADER_DEFAULT_NONE
	bool "Environment in RAM"
	depends on BOOTLOADER_NONE
	help
	  Use Environment in RAM as default bootloader interface.

endchoice

config BOOTLOADER_STATIC_LINKED
	bool "Bootloader interface static linked"
	help
	  Link statically the interface to the bootloader. In case of distros,
	  more interfaces are available at the same time and SWUpdate checks
	  at runtime and loads the interface via dlopen(). This is available
	  with glibc and dlopen support. For other system, the interface can be linked
	  statically.


choice
	prompt "Update Status Storage"
	help
	  Place to persistently store the update
	  status for, e.g., communicating it to SWUpdate after
	  a reboot.

config UPDATE_STATE_CHOICE_BOOTLOADER
	bool "Bootloader"
	depends on BOOTLOADER_EBG || UBOOT || BOOTLOADER_NONE || BOOTLOADER_GRUB
	help
	  Store update status in Bootloader's environment.
	  Specify Bootloader environment variable name to store update status in.

endchoice

config UPDATE_STATE_BOOTLOADER
	string "Store Update Status in Bootloader Environment variable"
	default "ustate"
	depends on UPDATE_STATE_CHOICE_BOOTLOADER
	help
	  Store update information in Bootloader's environment.
```

## configs/all_handlers_defconfig
```kconfig
# SPDX-FileCopyrightText: 2021 Stefano Babic <stefano.babic@swupdate.org>
# SPDX-License-Identifier: CC0-1.0
CONFIG_HW_COMPATIBILITY=y
CONFIG_LUAPKG="lua5.2"
CONFIG_EXTRA_CFLAGS="-g"
CONFIG_DOWNLOAD=y
CONFIG_SURICATTA=y
CONFIG_SURICATTA_SSL=y
CONFIG_WEBSERVER=y
CONFIG_MONGOOSESSL=y
CONFIG_HASH_VERIFY=y
CONFIG_ENCRYPTED_IMAGES=y
CONFIG_ZSTD=y
CONFIG_LUAEXTERNAL=y
CONFIG_ARCHIVE=y
CONFIG_BOOTLOADERHANDLER=y
CONFIG_CFI=y
CONFIG_DELTA=y
CONFIG_DISKPART=y
CONFIG_DISKPART_FORMAT=y
CONFIG_DISKFORMAT_HANDLER=y
CONFIG_FAT_FILESYSTEM=y
CONFIG_EXT_FILESYSTEM=y
CONFIG_LUASCRIPTHANDLER=y
CONFIG_RAW=y
CONFIG_RDIFFHANDLER=y
CONFIG_READBACKHANDLER=y
CONFIG_REMOTE_HANDLER=y
CONFIG_SHELLSCRIPTHANDLER=y
CONFIG_SWUFORWARDER_HANDLER=y
CONFIG_SSBLSWITCH=y
CONFIG_UBIVOL=y
CONFIG_UCFWHANDLER=y
CONFIG_UNIQUEUUID=y
```

## configs/bootloader_grub_defconfig
```kconfig
# SPDX-FileCopyrightText: 2021 Stefano Babic <sbabic@denx.de>
# SPDX-License-Identifier: CC0-1.0
CONFIG_SYSTEMD=y
CONFIG_HW_COMPATIBILITY=y
CONFIG_HW_COMPATIBILITY_FILE="tests/etc/hwrevision"
CONFIG_SW_VERSIONS_FILE="tests/etc/sw-versions"
# CONFIG_MTD is not set
CONFIG_LUAPKG="lua5.2"
CONFIG_EXTRA_CFLAGS="-g"
CONFIG_BOOTLOADER_GRUB=y
CONFIG_DOWNLOAD=y
CONFIG_HASH_VERIFY=y
CONFIG_ENCRYPTED_IMAGES=y
CONFIG_WEBSERVER=y
CONFIG_MONGOOSESSL=y
CONFIG_LUAEXTERNAL=y
CONFIG_RAW=y
CONFIG_LUASCRIPTHANDLER=y
CONFIG_SHELLSCRIPTHANDLER=y
CONFIG_HANDLER_IN_LUA=y
CONFIG_ARCHIVE=y
CONFIG_REMOTE_HANDLER=y
CONFIG_SWUFORWARDER_HANDLER=y
CONFIG_BOOTLOADERHANDLER=y
```

## configs/crypto_all_defconfig
```kconfig
# SPDX-FileCopyrightText: 2021 Stefano Babic <stefano.babic@swupdate.org>
# SPDX-License-Identifier: CC0-1.0
CONFIG_HW_COMPATIBILITY=y
CONFIG_LUAPKG="lua5.2"
CONFIG_EXTRA_CFLAGS="-g"
CONFIG_DOWNLOAD=y
CONFIG_DOWNLOAD_SSL=y
CONFIG_SURICATTA=y
CONFIG_SURICATTA_SSL=y
CONFIG_WEBSERVER=y
CONFIG_MONGOOSESSL=y
CONFIG_SSL_IMPL_WOLFSSL=y
CONFIG_SSL_IMPL_MBEDTLS=y
CONFIG_SIGNED_IMAGES=y
CONFIG_SIGALG_RAWRSA=y
CONFIG_SIGALG_RSAPSS=y
CONFIG_SIGALG_CMS=y
CONFIG_ENCRYPTED_IMAGES=y
CONFIG_ENCRYPTED_IMAGES_HARDEN_LOGGING=y
CONFIG_PKCS11=y
CONFIG_ZSTD=y
CONFIG_LUAEXTERNAL=y
CONFIG_ARCHIVE=y
CONFIG_BOOTLOADERHANDLER=y
CONFIG_CFI=y
CONFIG_DELTA=y
CONFIG_DISKPART=y
CONFIG_DISKPART_FORMAT=y
CONFIG_DISKFORMAT_HANDLER=y
CONFIG_FAT_FILESYSTEM=y
CONFIG_EXT_FILESYSTEM=y
CONFIG_LUASCRIPTHANDLER=y
CONFIG_RAW=y
CONFIG_RDIFFHANDLER=y
CONFIG_READBACKHANDLER=y
CONFIG_REMOTE_HANDLER=y
CONFIG_SHELLSCRIPTHANDLER=y
CONFIG_SWUFORWARDER_HANDLER=y
CONFIG_SSBLSWITCH=y
CONFIG_UBIVOL=y
CONFIG_UCFWHANDLER=y
CONFIG_UNIQUEUUID=y
```

## configs/debian_defconfig
```kconfig
CONFIG_SYSTEMD=y
CONFIG_HW_COMPATIBILITY=y
CONFIG_LUAPKG="lua5.2"
CONFIG_EXTRA_CFLAGS="-g"
CONFIG_BOOTLOADER_GRUB=y
CONFIG_DOWNLOAD=y
CONFIG_DOWNLOAD_SSL=y
CONFIG_SIGNED_IMAGES=y
CONFIG_ENCRYPTED_IMAGES=y
CONFIG_SURICATTA=y
CONFIG_SURICATTA_SSL=y
CONFIG_WEBSERVER=y
CONFIG_MONGOOSESSL=y
CONFIG_UBIVOL=y
CONFIG_CFI=y
CONFIG_CFIHAMMING1=y
CONFIG_RAW=y
CONFIG_LUASCRIPTHANDLER=y
CONFIG_SHELLSCRIPTHANDLER=y
CONFIG_HANDLER_IN_LUA=y
CONFIG_ARCHIVE=y
CONFIG_REMOTE_HANDLER=y
CONFIG_BOOTLOADERHANDLER=y
```

## configs/delta_defconfig
```kconfig
# SPDX-FileCopyrightText: 2023 Stefano Babic <stefano.babic@swupdate.org>
# SPDX-License-Identifier: CC0-1.0
CONFIG_HW_COMPATIBILITY=y
# CONFIG_MTD is not set
CONFIG_EXTRA_CFLAGS="-g"
CONFIG_DOWNLOAD=y
CONFIG_DOWNLOAD_SSL=y
CONFIG_SURICATTA=y
CONFIG_WEBSERVER=y
CONFIG_MONGOOSESSL=y
CONFIG_HASH_VERIFY=y
CONFIG_ENCRYPTED_IMAGES=y
CONFIG_ZSTD=y
CONFIG_LUAEXTERNAL=y
CONFIG_SETEXTPARSERNAME=y
CONFIG_EXTPARSERNAME="xmlparser.lua"
CONFIG_ARCHIVE=y
CONFIG_BOOTLOADERHANDLER=y
CONFIG_DELTA=y
CONFIG_DISKPART=y
CONFIG_DISKPART_FORMAT=y
CONFIG_DISKFORMAT_HANDLER=y
CONFIG_FAT_FILESYSTEM=y
CONFIG_EXT_FILESYSTEM=y
CONFIG_LUASCRIPTHANDLER=y
CONFIG_RAW=y
CONFIG_RDIFFHANDLER=y
CONFIG_READBACKHANDLER=y
CONFIG_REMOTE_HANDLER=y
CONFIG_SHELLSCRIPTHANDLER=y
CONFIG_SWUFORWARDER_HANDLER=y
CONFIG_UCFWHANDLER=y
CONFIG_UNIQUEUUID=y
```

## configs/hawkbit_defconfig
```kconfig
# SPDX-FileCopyrightText: 2021 Stefano Babic <stefano.babic@swupdate.org>
# SPDX-License-Identifier: CC0-1.0
CONFIG_HW_COMPATIBILITY=y
# CONFIG_MTD is not set
CONFIG_LUAPKG="lua5.2"
CONFIG_EXTRA_CFLAGS="-g"
CONFIG_DOWNLOAD=y
CONFIG_SURICATTA=y
CONFIG_WEBSERVER=y
CONFIG_MONGOOSESSL=y
CONFIG_HASH_VERIFY=y
CONFIG_ENCRYPTED_IMAGES=y
CONFIG_LUAEXTERNAL=y
CONFIG_ARCHIVE=y
CONFIG_BOOTLOADERHANDLER=y
CONFIG_LUASCRIPTHANDLER=y
CONFIG_RAW=y
CONFIG_REMOTE_HANDLER=y
CONFIG_SHELLSCRIPTHANDLER=y
```

## configs/no_ssl_defconfig
```kconfig
# SPDX-FileCopyrightText: 2021 Stefano Babic <sbabic@denx.de>
# SPDX-License-Identifier: CC0-1.0
CONFIG_HW_COMPATIBILITY=y
# CONFIG_MTD is not set
CONFIG_LUAPKG="lua5.2"
CONFIG_EXTRA_CFLAGS="-g"
CONFIG_BOOTLOADER_NONE=y
CONFIG_DOWNLOAD=y
CONFIG_HASH_VERIFY=y
CONFIG_WEBSERVER=y
CONFIG_JSON=y
CONFIG_LUAEXTERNAL=y
CONFIG_RAW=y
CONFIG_LUASCRIPTHANDLER=y
CONFIG_SHELLSCRIPTHANDLER=y
CONFIG_HANDLER_IN_LUA=y
CONFIG_ARCHIVE=y
CONFIG_REMOTE_HANDLER=y
CONFIG_BOOTLOADERHANDLER=y
```

## configs/raspi_defconfig
```kconfig
CONFIG_HW_COMPATIBILITY=y
CONFIG_LUAPKG="lua5.2"
CONFIG_BOOTLOADER_NONE=y
CONFIG_DOWNLOAD=y
CONFIG_HASH_VERIFY=y
CONFIG_ENCRYPTED_IMAGES=y
CONFIG_WEBSERVER=y
CONFIG_MONGOOSESSL=y
CONFIG_RAW=y
CONFIG_LUASCRIPTHANDLER=y
CONFIG_SHELLSCRIPTHANDLER=y
CONFIG_HANDLER_IN_LUA=y
CONFIG_ARCHIVE=y
CONFIG_REMOTE_HANDLER=y
```

## configs/with_lua_handlers_defconfig
```kconfig
# SPDX-FileCopyrightText: 2021 Stefano Babic <sbabic@denx.de>
# SPDX-License-Identifier: CC0-1.0
CONFIG_HW_COMPATIBILITY=y
CONFIG_LUAPKG="lua5.2"
CONFIG_EXTRA_CFLAGS="-g"
CONFIG_BOOTLOADER_NONE=y
CONFIG_DOWNLOAD=y
CONFIG_SIGNED_IMAGES=y
CONFIG_ENCRYPTED_IMAGES=y
CONFIG_WEBSERVER=y
CONFIG_MONGOOSESSL=y
CONFIG_CFI=y
CONFIG_RAW=y
CONFIG_LUASCRIPTHANDLER=y
CONFIG_SHELLSCRIPTHANDLER=y
CONFIG_HANDLER_IN_LUA=y
CONFIG_ARCHIVE=y
CONFIG_REMOTE_HANDLER=y
```

## configs/with_lua_nohandlers_defconfig
```kconfig
# SPDX-FileCopyrightText: 2021 Stefano Babic <stefano.babic@swupdate.org>
# SPDX-License-Identifier: CC0-1.0
CONFIG_HW_COMPATIBILITY=y
CONFIG_LUAPKG="lua5.2"
CONFIG_EXTRA_CFLAGS="-g"
CONFIG_DOWNLOAD=y
CONFIG_WEBSERVER=y
CONFIG_MONGOOSESSL=y
CONFIG_SIGNED_IMAGES=y
CONFIG_ENCRYPTED_IMAGES=y
# CONFIG_LIBCONFIG is not set
CONFIG_ARCHIVE=y
CONFIG_RAW=y
CONFIG_REMOTE_HANDLER=y
CONFIG_SHELLSCRIPTHANDLER=y
```

## configs/with_luajit_handlers_defconfig
```kconfig
# SPDX-FileCopyrightText: 2024 Michael Adler <michael.adler@siemens.com>
# SPDX-License-Identifier: CC0-1.0
CONFIG_LUAPKG="luajit"
CONFIG_EXTRA_CFLAGS="-g"
CONFIG_LUASCRIPTHANDLER=y
```

## configs/without_lua_defconfig
```kconfig
CONFIG_HW_COMPATIBILITY=y
# CONFIG_LUA is not set
CONFIG_EXTRA_CFLAGS="-g"
CONFIG_DOWNLOAD=y
CONFIG_SIGNED_IMAGES=y
CONFIG_ENCRYPTED_IMAGES=y
CONFIG_WEBSERVER=y
CONFIG_MONGOOSE=y
CONFIG_MONGOOSESSL=y
# CONFIG_LIBCONFIG is not set
CONFIG_RAW=y
CONFIG_SHELLSCRIPTHANDLER=y
CONFIG_ARCHIVE=y
CONFIG_REMOTE_HANDLER=y
```

## containers/Kconfig
```kconfig
# SPDX-FileCopyrightText: 2021 Weidmueller Interface GmbH & Co. KG
#
# SPDX-License-Identifier: GPL-2.0-only

menu "Update containers"

config DOCKER
	bool "Support Docker REST API"
	depends on HAVE_LIBCURL
	default n
	select CHANNEL_CURL
	help
	  Add native support for container. This implements a part of the REST API,
	  what is required to install new images.

comment "Docker support needs libcurl"
	depends on !HAVE_LIBCURL

endmenu
```

## crypto/Kconfig
```kconfig
# SPDX-FileCopyrightText: 2024 Stefano Babic <stefano.babic@swupdate.org>
#
# SPDX-License-Identifier: GPL-2.0-only

menu "Crypto libraries"
	config SSL_IMPL_OPENSSL
		bool "OpenSSL"
		default y
		depends on HAVE_LIBSSL

	config SSL_IMPL_WOLFSSL
		bool "wolfSSL (with OpenSSL compatibility layer)"
		depends on HAVE_WOLFSSL
		select CMS_IGNORE_CERTIFICATE_PURPOSE if SIGALG_CMS
		select CMS_SKIP_UNKNOWN_SIGNERS if SIGALG_CMS

	config SSL_IMPL_MBEDTLS
		bool "mbedTLS"
		depends on HAVE_MBEDTLS

	config SSL_IMPL_GPGME
		bool "gpgme"
		depends on HAVE_GPGME

	config PKCS11
		bool "PKCS#11 (p11-kit)"
		depends on HAVE_P11KIT
endmenu

config HASH_VERIFY
	bool "Allow to add sha256 hash to each image"
	depends on SSL_IMPL_OPENSSL || SSL_IMPL_WOLFSSL || SSL_IMPL_MBEDTLS
	help
	  Allow to add a sha256 hash to an artifact.
	  This is automatically set in case of Signed Image

comment "Hash checking needs an SSL implementation"
	depends on !SSL_IMPL_OPENSSL && !SSL_IMPL_WOLFSSL && !SSL_IMPL_MBEDTLS

config SIGNED_IMAGES
	bool "Enable verification of signed images"
	depends on SSL_IMPL_OPENSSL || SSL_IMPL_WOLFSSL || SSL_IMPL_MBEDTLS
	select HASH_VERIFY
comment "Image signature verification needs an SSL implementation"
	depends on !SSL_IMPL_OPENSSL && !SSL_IMPL_WOLFSSL && !SSL_IMPL_MBEDTLS

menu "Signature verification algorithm"
	depends on SIGNED_IMAGES

	config SIGALG_RAWRSA
		bool "RSA PKCS#1.5"
		default y
		depends on SSL_IMPL_OPENSSL || SSL_IMPL_WOLFSSL || SSL_IMPL_MBEDTLS

	config SIGALG_RSAPSS
		bool "RSA PSS"
		default n
		depends on SSL_IMPL_OPENSSL || SSL_IMPL_WOLFSSL || SSL_IMPL_MBEDTLS

	config SIGALG_CMS
		bool "Cryptographic Message Syntax (CMS) / PKCS#7"
		depends on SSL_IMPL_OPENSSL || SSL_IMPL_WOLFSSL

	config SIGALG_GPG
		bool "GPG signing"
		depends on SSL_IMPL_GPGME
endmenu

menu "CMS / PKCS#7 signature verification options"
	depends on SIGALG_CMS

config CMS_IGNORE_EXPIRED_CERTIFICATE
	bool "Ignore expired certificates"
	depends on SIGALG_CMS

config CMS_IGNORE_CERTIFICATE_PURPOSE
	bool "Ignore X.509 certificate purpose"
	depends on SIGALG_CMS

config CMS_SKIP_UNKNOWN_SIGNERS
	bool "Ignore unverifiable signatures if known signer verifies"
	depends on SIGALG_CMS
endmenu

menu "Encryption"

config ENCRYPTED_IMAGES
	bool "Images can be encrypted with a symmetric key"
	depends on SSL_IMPL_OPENSSL || SSL_IMPL_WOLFSSL || SSL_IMPL_MBEDTLS || PKCS11
comment "Image encryption needs an SSL implementation"
	depends on !SSL_IMPL_OPENSSL && !SSL_IMPL_WOLFSSL && !SSL_IMPL_MBEDTLS && !PKCS11

config ENCRYPTED_SW_DESCRIPTION
	bool "Even sw-description is encrypted"
	depends on ENCRYPTED_IMAGES
	help
	  sw-description is not encrypted as default, but it is encrypted
	  if this is set. It is a compile time option, and mix of plain and
	  encrypted sw-descriptions is not possible.

config ASYM_ENCRYPTED_SW_DESCRIPTION
	bool "Asymmetrical encrypted sw-description"
	depends on ENCRYPTED_SW_DESCRIPTION
	select SIGALG_ASYM_DEC_CMS
	default n
	help
	  This option enables support for asymmetrical encrypted sw-description,
	  making it possible to decrypt images device specific.

menu "Asymmetric decryption algorithm"
	depends on ASYM_ENCRYPTED_SW_DESCRIPTION

	config SIGALG_ASYM_DEC_CMS
		bool "Cryptographic Message Syntax (CMS) / PKCS#7"
		default n
		depends on SSL_IMPL_OPENSSL
endmenu

config ENCRYPTED_IMAGES_HARDEN_LOGGING
	bool "Harden logging for encrypted images"
	default n
	depends on ENCRYPTED_IMAGES
	help
	  This option addresses a theoretical weakness of the AES-CBC encryption in
	  combination with streamed images. An adversary can target each 16-byte
	  block of encrypted data within an image and decrypt it, if they can apply a
	  huge amount of manipulated firmware updates and observe the logged
	  messages. On average, 2048 update attempts are needed for each block.
	  Select if this scenario poses a risk. If set, log messages related to a
	  hash mismatch and errors in the decryption finalization (padding) of a
	  streamed image are suppressed.

endmenu
```
