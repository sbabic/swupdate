## fatfs/Config.in
```kconfig
config FAT_FILESYSTEM
	bool "FAT file system creation support"
	depends on DISKFORMAT
	default n
	help
	  Enable support for creating FAT file systems.
```

## fs/Config.in
```kconfig
# SPDX-FileCopyrightText: 2021 Weidmueller Interface GmbH & Co. KG
#
# SPDX-License-Identifier: GPL-2.0-only

if DISKFORMAT
config FAT_FILESYSTEM
	bool "FAT file system creation support"
	default n
	help
	  Enable support for creating FAT file systems.

config EXT_FILESYSTEM
	bool "EXT2 / EXT3 / EXT4 file system creation support"
	depends on HAVE_LIBEXT2FS
	default n
	help
	  Enable support for creating EXT file systems.

comment "EXT2 / EXT3 / EXT4 file system creation support needs libext2fs"
	depends on !HAVE_LIBEXT2FS

config BTRFS_FILESYSTEM
	bool "BTRFS file system creation support"
	depends on HAVE_LIBBTRFS
	default n
	help
	  Enable support for creating BTRFS file systems.

comment "BTRFS file system creation support needs libbtrfs libbtrfsutil"
	depends on !HAVE_LIBBTRFS

config BTRFS_FILESYSTEM_USELIBMKFS
	bool "Use modified source from btrfs tool to be linked as lib"
	depends on HAVE_LIBBTRFS
	default n
	help
	  This requires at the moment a patched version of btrfs-tool to export
	  mkfs.btrf as library.

comment "BTRFS file system creation support needs libbtrfs libbtrfsutil"
	depends on !HAVE_LIBBTRFS

endif
```

## handlers/Config.in
```kconfig
#
# For a description of the syntax of this configuration file,
# see scripts/kbuild/config-language.txt.
#

menu "Image Handlers"

config UBIVOL
	bool "ubivol"
	default n
	depends on HAVE_LIBUBI
	depends on MTD
	help
	  ubi is the default format for NAND device.
	  Say Y if you have NAND or you use UBI on
	  your system.

comment "ubivol support needs libubi"
	depends on !HAVE_LIBUBI

config UBIATTACH
	bool "Automatically attach UBI devices"
	default y
	depends on UBIVOL
	help
	  If this option is enabled, swupdate will try to attach
	  UBI devices to all MTD devices.

	  Make sure UBIBLACKLIST or UBIWHITELIST is set correctly,
	  since attaching a UBI device will write to it if it is
	  found to be empty, and that may destroy already existing
	  content on that device.

config UBIBLACKLIST
	string "List of MTD devices to be excluded for UBI"
	depends on UBIATTACH
	help
	  Define a list of MTD devices that are excluded
	  by scan_mtd_device. The devices are still available
	  as raw devices.
	  The list can be set as a string with the mtd numbers.
	  Examples: "0 1 2"
	  This excludes mtd0-mtd1-mtd2 to be searched for UBI volumes

config UBIWHITELIST
	string "List of MTD devices that must have UBI"
	depends on UBIATTACH
	help
	  Define a list of MTD devices that are planned to have
	  always UBI. If first attach fails, the device is erased
	  and tried again.
	  The list can be set as a string with the mtd numbers.
	  Examples: "0 1 2"
	  This sets mtd0-mtd1-mtd2 to be used as UBI volumes.
	  UBIBLACKLIST has priority on UBIWHITELIST.

config UBIVIDOFFSET
	int "VID Header Offset"
	depends on UBIATTACH
	default 0
	help
	  Force UBI to set a VID header offset to be 2048 bytes
	  instead of the value reported by the kernel.
	  In other words, you may ask UBI to avoid using sub-pages.
	  This is not recommended since this will require
	  more storage overhead, but may be useful
	  if your NAND driver incorrectly reports that it can handle
	  sub-page accesses when it should not.

config CFI
	bool "cfi"
	depends on MTD
	default n
	help
	  Handler to store images in flash in raw mode,
	  without UBI

config CFIHAMMING1
	bool "NAND in raw mode with 1bit Hamming OOB (TI)"
	depends on MTD
	default n
	help
	  On certain TI's omaps (for example, DM3730 or AM3517),
	  the first bootloader (MLO or SPL) must be saved with one bit
	  Hamming correction because this is requested by the SOC's ROM.
	  However, the Linux driver must use for the rest of the NAND a more
	  powerful algorithm to make data reliable, and this causes that
	  it is not possible to update SPL by letting the driver to handle
	  the OOB area. This handler raws the NAND in raw mode, computing
	  the ECC with 1 bit Hamming Code and saving it into OOB
	  (assumes sector size of 512 and page size of 2048).

	  You do not need this if you do not have an OMAP SoC.

config DISKPART
	bool "diskpart"
	depends on HAVE_LIBFDISK
	default n
	help
	  Handler to partition a disk, eMMC or SD

comment "diskpart support needs libfdisk"
	depends on !HAVE_LIBFDISK

if DISKPART

menuconfig DISKFORMAT
        bool "diskpart extension for creating file systems"
	depends on DISKPART
	default n
	help
	  This extension of the diskpart handler allows creating filesystems
	  on empty partitions.

if DISKFORMAT

source fatfs/Config.in

endif

endif

config UNIQUEUUID
	bool "uniqueuuid"
	depends on HAVE_LIBBLKID
	default n
	help
	  This handler checks that no filesystem on the device has
	  a UUID from a list (list is added as part of "properties"
	  in sw-description) for this handler.
	  This is useful for bootloader (like GRUB) that use UUID to
	  select the partition to be started, and in case two or
	  more filesystem have the same UUID, a wrong one is started.
	  This handler is a partition handler and it is guaranteed that
	  it runs before any image is installed on the device.

comment "uniqueuuid support needs libblkid"
	depends on !HAVE_LIBBLKID

config RAW
	bool "raw"
	default n
	help
	  This is a simple handler that simply copies
	  into the destination.

config RDIFFHANDLER
	bool "rdiff"
	default n
	help
	  Add support for applying librsync's rdiff patches,
	  see http://librsync.sourcefrog.net/

config READBACKHANDLER
	bool "readback"
	depends on HASH_VERIFY
	default n
	help
	  To verify that an image was written properly, this readback handler
	  calculates the sha256 hash of a partition (or part of it) and compares
	  it against a given hash value.

	  This is a post-install handler running at the same time as
	  post-install scripts.

config LUASCRIPTHANDLER
	bool "Lua Script"
	depends on LUA
	default n
	help
	  Handler to be called for pre- and post scripts
	  written in Lua.

config SHELLSCRIPTHANDLER
	bool "shellscript"
	default n
	help
	  Handler to be called for pre- and post scripts
	  written as shell scripts. The default shell /bin/sh
	  is called.

config HANDLER_IN_LUA
	bool "Handlers in Lua"
	depends on LUASCRIPTHANDLER
	default n
	help
	  Allow to write own handlers in Lua.
	  They are loaded at the start-up.

config EMBEDDED_LUA_HANDLER
	bool "Embed Lua handler in SWUpdate binary"
	depends on HANDLER_IN_LUA
	default n
	help
	  Embed the Lua handler source code file into the
	  SWUpdate binary.

	  If enabled, a swupdate_handlers.lua will *not*
	  be loaded from disk at SWUpdate startup.

	  Note: Exactly one Lua source code file is embedded
	  into the binary, i.e., possible dependencies either
	  have to be deployed on the target system or put into
	  the one embedded Lua source code file.

config EMBEDDED_LUA_HANDLER_SOURCE
	string "Lua handler file"
	depends on EMBEDDED_LUA_HANDLER
	default "swupdate_handlers.lua"
	help
	  Path to the Lua handler source code file to be
	  embedded into the SWUpdate binary.

config ARCHIVE
	bool "archive"
	depends on HAVE_LIBARCHIVE
	default n
	help
	  Handler using the libarchive to extract tarballs
	  into a filesystem.

comment "archive support needs libarchive"
	depends on !HAVE_LIBARCHIVE
	
config LOCALE
	bool "Locale support for filenames"
	depends on ARCHIVE
	default y
	help
	  Option to remove attempts to use locale in systems
	  without locale support in toolchain.

config REMOTE_HANDLER
	bool "Remote handler"
	depends on HAVE_LIBZEROMQ
	default n
	help
	  Sometimes the update process should be done
	  by another process, where code is already
	  provided. The remote handler let communicate
	  an external process with SWUpdate, sending
	  the image to be updated with the help of the
	  zeromq library.

comment "remote handler needs zeromq"
	depends on !HAVE_LIBZEROMQ

config SWUFORWARDER_HANDLER
	bool "SWU forwarder"
	depends on HAVE_LIBCURL
	depends on HAVE_JSON_C
	depends on HAVE_LIBWEBSOCKETS
	depends on HAVE_URIPARSER
	select CHANNEL_CURL
	select JSON
	default n
	help
	  This allows to build a chain of updater. A
	  SWU can contains other SWUs for other systems.
	  The handler takes a list of URLs and forward the
	  embedded SWU to the other devices using the
	  Webserver REST API.

comment "swuforward handler needs json-c and libcurl"
	depends on !HAVE_JSON_C || !HAVE_LIBCURL

comment "swuforward handler needs websockets and uriparser"
	depends on !HAVE_LIBWEBSOCKETS || !HAVE_URIPARSER

config BOOTLOADERHANDLER
	bool "bootloader"
	default n
	help
	  Enable it to change bootloader environment
	  during the installation process.

config SSBLSWITCH
	bool "Second Stage Switcher"
	depends on MTD
	default n
	help
	  This handler allows to switch between two software set
	  based on an administration block stored in flash (CFI interface).
	  It works like the switch of UBI and allow to switch in an atomic
	  way between two software set. It can be used to reliable update
	  a second stage bootloader.

config UCFWHANDLER
	bool "microcontroller firmware update"
	depends on HAVE_LIBGPIOD
	default n
	help
	  Simple protocol to upgrade a microcontroller
	  via UART.

comment "Microcontroller handler depends on libgpiod"
	depends on !HAVE_LIBGPIOD

config UCFW_OLD_LIBGPIOD
	bool "Support older libgpiod version"
	depends on HAVE_LIBGPIOD
	depends on UCFWHANDLER
	default n
	help
	  The libgpiod library changed the api gpiod_line_request_output.
	  The old function was replaced by gpiod_line_request_flags_output
	  while the new one dropped "flags" from the list of parameters.
	  Rather there is no way to get this changes from the library
	  at build time.

endmenu
```

## mongoose/Config.in
```kconfig
# SPDX-FileCopyrightText: 2013 Stefano Babic <sbabic@denx.de>
#
# SPDX-License-Identifier: GPL-2.0-only

menuconfig WEBSERVER
	bool "Web Server"
	select MONGOOSE
	help
	  Enable update from remote using a web server on the target.

if WEBSERVER
choice
	prompt "Web Server Type"
	default MONGOOSE
	help
	  Choose the web server

config MONGOOSE
	bool "mongoose"
	help
	  Mongoose embeddded web server

endchoice

config MONGOOSEIPV6
	bool "IPv6 support"
	default y
	depends on MONGOOSE
	help
	   It enables ipv6 support into mongoose

config MONGOOSESSL
	bool "SSL support"
	depends on MONGOOSE
	depends on SSL_IMPL_OPENSSL || SSL_IMPL_WOLFSSL || SSL_IMPL_MBEDTLS
	help
	   It enables SSL support into mongoose

comment "SSL support needs an SSL implementation"
	depends on !SSL_IMPL_OPENSSL && !SSL_IMPL_WOLFSSL && !SSL_IMPL_MBEDTLS

endif
```

## parser/Config.in
```kconfig
# SPDX-FileCopyrightText: 2013 Stefano Babic <sbabic@denx.de>
#
# SPDX-License-Identifier: GPL-2.0-only

menu "Parser Features"

config LIBCONFIG
	bool "libconfig"
	default y
	depends on HAVE_LIBCONFIG
	help
	  Use libconfig to parse the configuration file.
	  This is the default parser.

comment "Default config parser support needs libconfig"
	depends on !HAVE_LIBCONFIG

config PARSERROOT
	string "Name of root node"
	depends on LIBCONFIG || JSON
	help
	  For compatibility reasons, the root node
	  can be set to something else as "software".
	  In most case you do not need to set it.

config JSON
	bool "libjson"
	default n
	depends on HAVE_JSON_C
	help
	  Use json-c to parse the configuration file.
	  Also required for suricatta's hawkBit Server support.

comment "JSON config parser support needs json-c"
	depends on !HAVE_JSON_C

config LUAEXTERNAL
	bool "lua"
	depends on LUA
	default n
	help
	  call an external parser written in Lua.

config SETEXTPARSERNAME
	bool "Set external parser name"
	depends on LUAEXTERNAL
	default n
	help
	  Set to define own path and filename for the
	  external parser, else default lua-tools/extparser.lua
	  will be used.

config EXTPARSERNAME
	string "External parser file name"
	depends on SETEXTPARSERNAME
	help
	  Lua script to be executed for parsing
	  the sw-description file.

config SETSWDESCRIPTION
	bool "set file description name"
	default n
	help
	  Set it if you want to change the name of
	  the default software descritpion file.
	  If not set, default file name is "sw-description"

config SWDESCRIPTION
	string "description file"
	depends on SETSWDESCRIPTION
	help
	   File extracted from the image containing
	   the description (meta) of the images.
	   This file, after extraction, is passed to the parser.
endmenu
```

## suricatta/Config.in
```kconfig
# SPDX-FileCopyrightText: 2016 Christian Storm <christian.storm@tngtech.com>
#
# SPDX-License-Identifier: GPL-2.0-only

menuconfig SURICATTA
	bool "Suricatta"
	depends on HAVE_LIBCURL
	help
	  Suricatta is a daemon mode of SWUpdate.

	  Suricatta regularly polls a remote server for updates,
	  downloads, and installs them. Thereafter, it reboots the
	  system and reports the update status to the server, based
	  on an update state variable currently stored in bootloader’s
	  environment ensuring persistent storage across reboots. Some
	  U-Boot script logics or U-Boot’s bootcount feature may be
	  utilized to alter this update state variable, e.g., by
	  setting it to reflect failure in case booting the newly
	  flashed root file system has failed and a switchback had to
	  be performed.

if SURICATTA

menu "Features"

config SURICATTA_SSL
	bool "SSL support"
	default n
	select CHANNEL_CURL_SSL
	help
	  Enable SSL and checksum verification support in suricatta.

endmenu

menu "Server"

choice
	prompt "Server Type"
	default SURICATTA_HAWKBIT
	help
	  Choose the server type. Currently, just hawkBit is
	  supported.

config SURICATTA_HAWKBIT
	bool "hawkBit support"
	depends on HAVE_JSON_C
	select CHANNEL_CURL
	select JSON
	help
	  Support for hawkBit server.
	  https://projects.eclipse.org/projects/iot.hawkbit

comment "hawkBit support needs json-c"
	depends on !HAVE_JSON_C

config SURICATTA_LUA
	bool "Suricatta Lua module"
	depends on HAVE_LIBCURL
	depends on HAVE_LUA
	select CHANNEL_CURL
	help
	  Support for Suricatta modules in Lua.

	  The optional JSON support for Suricatta Lua modules
	  provides JSON as Lua Tables to the Lua realm and
	  enables channel result parsing to JSON per default.
	  To enable, select 'libjson' in 'Parser Features'.
	
config EMBEDDED_SURICATTA_LUA
	bool "Embed Suricatta Lua module in SWUpdate binary"
	depends on SURICATTA_LUA
	default n
	help
	  Embed the Suricatta Lua module source code file into
	  the SWUpdate binary.

	  If enabled, a swupdate_suricatta.lua will *not*
	  be loaded from disk at SWUpdate startup.

	  Note: Exactly one Lua source code file is embedded
	  into the binary, i.e., possible dependencies either
	  have to be deployed on the target system or put into
	  the one embedded Lua source code file.

config EMBEDDED_SURICATTA_LUA_SOURCE
	string "Suricatta Lua module file"
	depends on EMBEDDED_SURICATTA_LUA
	default "swupdate_suricatta.lua"
	help
	  Path to the Suricatta Lua module source code file to
	  be embedded into the SWUpdate binary.

comment "Suricatta Lua module support needs libcurl and Lua"
	depends on !HAVE_LIBCURL || !HAVE_LUA

comment "Suricatta Lua module JSON support needs json-c"
	depends on SURICATTA_LUA && !JSON

config SURICATTA_GENERAL
	bool "General HTTP support"
	depends on HAVE_JSON_C
	select CHANNEL_CURL
	select JSON
	help
	  Support for Simple HTTP coded server
	  The server uses HTTP return codes to detect if an update
	  is available. See documentation for more details.

endchoice

endmenu

endif

comment "Suricatta daemon support needs libcurl"
	depends on !HAVE_LIBCURL
```
